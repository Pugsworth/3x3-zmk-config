## boards/shields/macropad_rc/Kconfig.defconfig
```kconfig
if SHIELD_MACROPAD_RC

config ZMK_KEYBOARD_NAME
    default "macropad-rc"

endif # SHIELD_MACROPAD_RC
```

## boards/shields/photo-cull/Kconfig.defconfig
```kconfig
if SHIELD_PHOTO_CULL

# Name must be less than 16 characters long!
config ZMK_KEYBOARD_NAME
    default "Photo Cull"

endif
```

## boards/shields/photo-cull/Kconfig.shield
```kconfig
# No whitespace after the comma or in your keyboard name!
config SHIELD_PHOTO_CULL
    def_bool $(shields_list_contains,photo-cull)
```
